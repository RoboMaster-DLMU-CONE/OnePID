## west.yml
```yaml
manifest:
  version: "1.2"

  defaults:
    remote: origin

  remotes:
    - name: zephyrproject-rtos
      url-base: https://github.com/zephyrproject-rtos
    - name: origin
      url-base: https://github.com/RoboMaster-DLMU-CONE

  projects:
    - name: zephyr
      remote: zephyrproject-rtos
      revision: main
      import:
        name-allowlist:
          - cmsis
          - cmsis_6
    - name: OnePID
      repo-path: OnePID
      path: modules/lib/onepid
      revision: main

  self:
    path: modules/lib/onepid
```

## zephyr/Kconfig
```kconfig
config ONE_PID
    bool "OnePID library support"
    select CPP
    select REQUIRES_FULL_LIBCPP
    help
      Enable OnePID library for pid control.

if ONE_PID

choice STD_CPP
    prompt "C++ Standard"
    depends on CPP
    default STD_CPP20
endchoice

module = ONE_PID
module-str = OnePID
source "subsys/logging/Kconfig.template.log_config"

endif # ONE_PID
```
